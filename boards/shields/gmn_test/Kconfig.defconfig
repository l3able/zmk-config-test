## boards/shields/gmn_test/Kconfig.defconfig
```kconfig
if SHIELD_GMN_TEST

config ZMK_KEYBOARD_NAME
    default "gmn_test"

# Mouse: stick + left/right click
config ZMK_POINTING
    default y

# Analog stick (badjeff/zmk-analog-input-driver)
config ADC
    default y

config ANALOG_INPUT
    default y

config INPUT
    default y

# SSD1306 display (текстовий статус: шар, батарея, USB/BLE)
config ZMK_DISPLAY
    default y

config I2C
    default y

config SSD1306
    default y

config ZMK_DISPLAY_INVERT
    default y

if LVGL

config LV_Z_VDB_SIZE
    default 64

config LV_DPI_DEF
    default 148

config LV_Z_BITS_PER_PIXEL
    default 1

choice LV_COLOR_DEPTH
    default LV_COLOR_DEPTH_1
endchoice

endif # LVGL

# Display: show last key row/column on status screen
config ZMK_WIDGET_KEY_POSITION_STATUS
    default y

endif # SHIELD_GMN_TEST
```

## boards/shields/gmn_test/patches/Kconfig.key_position_fragment
```kconfig
config ZMK_WIDGET_KEY_POSITION_STATUS
    bool "Widget for last key position (row/column)"
    depends on !ZMK_SPLIT || ZMK_SPLIT_ROLE_CENTRAL
    select LV_USE_LABEL

config ZMK_WIDGET_MODIFIERS_STATUS
    bool "Widget for modifier keys state (Ctrl/Shift/Alt/Gui)"
    depends on !ZMK_SPLIT || ZMK_SPLIT_ROLE_CENTRAL
    select LV_USE_LABEL

config ZMK_WIDGET_STICK_XY_STATUS
    bool "Widget for analog stick X/Y coordinates"
    depends on !ZMK_SPLIT || ZMK_SPLIT_ROLE_CENTRAL
    depends on ADC
    select LV_USE_LABEL
```
